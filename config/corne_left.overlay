/*
 * Left-half column override.
 *
 * Upstream corne_left.overlay drives column 0 from D21 (P0.31) and column 1
 * from D20 (P0.29). This board needs the reverse: the column that was reached
 * through P0.29 now lives on P0.31.
 *
 * P0.31 was already taken by column 0, so the two pins trade places rather
 * than one moving onto the other -- two columns sharing a GPIO would be driven
 * together and every key in both would register at once. Column 0 is the outer
 * pinky column, which is &trans on every layer of this keymap, so it is the
 * one that can afford to take P0.29.
 *
 * Only the pins change. Column order, and therefore the keymap, is untouched.
 */

&kscan0 {
    col-gpios
        = <&pro_micro 20 GPIO_ACTIVE_HIGH>  /* col 0  P0.29  was pro_micro 21 */
        , <&pro_micro 21 GPIO_ACTIVE_HIGH>  /* col 1  P0.31  was pro_micro 20 */
        , <&pro_micro 19 GPIO_ACTIVE_HIGH>  /* col 2  P0.02 */
        , <&pro_micro 18 GPIO_ACTIVE_HIGH>  /* col 3  P1.15 */
        , <&pro_micro 15 GPIO_ACTIVE_HIGH>  /* col 4  P1.13 */
        , <&pro_micro 14 GPIO_ACTIVE_HIGH>  /* col 5  P1.11 */
        ;
};
