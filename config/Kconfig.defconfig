## config/Kconfig.defconfig
```kconfig
if SHIELD_CORNE_DONGLE

config ZMK_KEYBOARD_NAME
    default "CORNE"
    
config ZMK_SPLIT_ROLE_CENTRAL
    default y

config ZMK_SPLIT_BLE_CENTRAL_PERIPHERALS
    default 2

config ZMK_USB
    default y

config ZMK_SPLIT
	default y

config ZMK_BLE
    default y

endif

if SHIELD_CORNE_LEFT || SHIELD_CORNE_RIGHT

config ZMK_SPLIT
	default y

config ZMK_BLE
    default y

endif
```

## config/boards/shields/corne_dongle/Kconfig.shield
```kconfig
# Copyright (c) 2022 The ZMK Contributors
# SPDX-License-Identifier: MIT

config SHIELD_CORNE_DONGLE
    def_bool $(shields_list_contains,corne_dongle)
```
